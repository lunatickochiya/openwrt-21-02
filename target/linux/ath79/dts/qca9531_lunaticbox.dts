// SPDX-License-Identifier: GPL-2.0-or-later OR MIT

#include "qca9531_glinet_gl-ar300m.dtsi"

/ {
	compatible = "lunatic,lunaticbox", "qca,qca9531";
	model = "LunaticBox";
};

/delete-node/ &nand_flash;

&nor_firmware {
	compatible = "denx,uimage";
	label = "firmware";
};
